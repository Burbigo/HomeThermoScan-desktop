#include <Wire.h>
#include <Adafruit_MLX90614.h>
#include <Servo.h>

Adafruit_MLX90614 mlx;
Servo myServo1;
Servo myServo2;  
bool repeat = true;

void setup() {
  mlx = Adafruit_MLX90614();
  Serial.begin(9600);
  myServo1.attach(9);
  myServo2.attach(10);
  pinMode(13, OUTPUT);
  mlx.begin();
}

void loop() {
  while(repeat) {
    digitalWrite(13, HIGH);
    for(int i = 60; i < 120; i++) {
      myServo1.write(65);
      delay(100);
      myServo1.write(i);
      delay(50);
      for(int j = 65; j < 110; j++) {
        myServo2.write(j);
        delay(50);
        Serial.print(mlx.readObjectTempC());
        Serial.print(' ');
      }
      Serial.println();
    }
    repeat = false;
  } 
}
